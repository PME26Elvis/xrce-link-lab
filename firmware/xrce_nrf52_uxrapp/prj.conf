## CMakeLists.txt
```
cmake_minimum_required(VERSION 3.20.0)
find_package(Zephyr REQUIRED HINTS $ENV{ZEPHYR_BASE})
project(xrce_nrf52_uxrapp)

# 永遠編的最小 app
target_sources(app PRIVATE
  src/main.c
)

# uxrclient 目錄（CI 的 fetch 步驟會把 repo 放到這裡）
set(UXRCLIENT_DIR ${CMAKE_CURRENT_SOURCE_DIR}/third_party/uxrclient CACHE PATH "Path to micro-xrce-dds-client")

if (EXISTS ${UXRCLIENT_DIR}/include/uxr/client/client.h)
  message(STATUS "Building with micro-xrce-dds-client from: ${UXRCLIENT_DIR}")
  target_compile_definitions(app PRIVATE USE_UXRCLIENT=1)
  target_include_directories(app PRIVATE ${UXRCLIENT_DIR}/include)

  # 我們自己的 serial transport（只有在 USE_UXRCLIENT 時才編）
  target_sources(app PRIVATE
    src/transport_zephyr_serial.c
  )

  # 精確收集 uxrclient 必要 .c
  file(GLOB_RECURSE UXR_CORE_C   ${UXRCLIENT_DIR}/src/c/core/*.c)
  file(GLOB         UXR_UTIL_C   ${UXRCLIENT_DIR}/src/c/util/*.c)
  file(GLOB         UXR_SERIAL_C ${UXRCLIENT_DIR}/src/c/transport/serial/*.c)

  target_sources(app PRIVATE
    ${UXR_CORE_C}
    ${UXR_UTIL_C}
    ${UXR_SERIAL_C}
  )
else()
  message(STATUS "micro-xrce-dds-client NOT found; building heartbeat-only app.")
endif()
```

## prj.conf
```kconfig
CONFIG_SERIAL=y
CONFIG_UART_CONSOLE=y
CONFIG_CONSOLE=y
CONFIG_PRINTK=y
CONFIG_LOG=y
CONFIG_LOG_MODE_MINIMAL=y
CONFIG_MAIN_STACK_SIZE=3072

CONFIG_POSIX_API=n
CONFIG_NEWLIB_LIBC=n
```

## src/main.c
```c
#include <zephyr/kernel.h>
#include <zephyr/sys/printk.h>

#ifdef USE_UXRCLIENT
  #include <uxr/client/client.h>
  #include <uxr/client/transport/serial/serial_transport.h>
  #include "transport_zephyr_serial.h"
  #define CLIENT_KEY  0xAABBCCDDu
#endif

void main(void)
{
#ifndef USE_UXRCLIENT
    /* 沒有 uxrclient：走最小心跳，確保 zephyr-build-uxrapp 永遠綠燈 */
    printk("xrce_nrf52_uxrapp: heartbeat-only build (no uxrclient)\n");
    int i = 0;
    while (1) {
        printk("[uxrapp %04d] heartbeat\n", i++);
        k_sleep(K_MSEC(500));
    }
#else
    /* 有 uxrclient：建立 serial transport + session */
    printk("xrce_nrf52_uxrapp: XRCE build\n");

    uxrSerialTransport transport;
    if (!uxr_init_zephyr_serial_transport(&transport, 115200)) {
        printk("transport init failed\n");
        return;
    }

    /* 注意：在 Zephyr 上，我們自備 transport 平台，不依賴 dev 路徑字串。 */
    if (!uxr_init_serial_transport(&transport, "ignored-on-zephyr", 115200)) {
        printk("uxr_init_serial_transport failed\n");
        return;
    }

    uxrSession session;
    uxr_init_session(&session, &transport.comm, CLIENT_KEY);

    if (!uxr_create_session(&session)) {
        printk("uxr_create_session failed\n");
        return;
    }

    printk("XRCE: session established\n");

    while (1) {
        uxr_run_session_time(&session, 50);
        printk("tick\n");
        k_sleep(K_MSEC(500));
    }
#endif
}
```

## src/transport_zephyr_serial.c
```c
#include "transport_zephyr_serial.h"

#ifdef USE_UXRCLIENT

#include <zephyr/drivers/uart.h>
#include <zephyr/kernel.h>
#include <zephyr/device.h>
#include <zephyr/devicetree.h>
#include <stdlib.h>

typedef struct {
    const struct device* dev;
} zephyr_serial_platform;

bool uxr_init_zephyr_serial_transport(uxrSerialTransport* transport, uint32_t baudrate)
{
    ARG_UNUSED(baudrate);
    zephyr_serial_platform* plat = (zephyr_serial_platform*)malloc(sizeof(*plat));
    if (!plat) return false;

    const struct device* u = DEVICE_DT_GET(DT_NODELABEL(uart0));
    if (!device_is_ready(u)) {
        free(plat);
        return false;
    }
    plat->dev = u;
    transport->platform = plat;
    return true;
}

/* uxrclient 會連結以下符號 */
bool uxr_close_serial_transport(uxrSerialTransport* transport)
{
    if (transport && transport->platform) {
        free(transport->platform);
        transport->platform = NULL;
    }
    return true;
}

size_t uxr_write_serial_data(uxrSerialTransport* transport,
                             const uint8_t* buf, size_t len, uint8_t* err)
{
    zephyr_serial_platform* plat = (zephyr_serial_platform*)transport->platform;
    for (size_t i = 0; i < len; ++i) {
        uart_poll_out(plat->dev, buf[i]);
    }
    if (err) *err = 0;
    return len;
}

size_t uxr_read_serial_data(uxrSerialTransport* transport,
                            uint8_t* buf, size_t len, int timeout_ms, uint8_t* err)
{
    zephyr_serial_platform* plat = (zephyr_serial_platform*)transport->platform;
    size_t n = 0;
    int64_t end = k_uptime_get() + timeout_ms;
    while (n < len && k_uptime_get() < end) {
        unsigned char c;
        if (uart_poll_in(plat->dev, &c) == 0) {
            buf[n++] = c;
        } else {
            k_sleep(K_USEC(200));
        }
    }
    if (err) *err = 0;
    return n;
}

#endif /* USE_UXRCLIENT */
```

## src/transport_zephyr_serial.h
```c
#pragma once
#include <stdbool.h>
#include <stdint.h>

#ifdef USE_UXRCLIENT
  #include <uxr/client/transport/serial/serial_transport.h>
  bool uxr_init_zephyr_serial_transport(uxrSerialTransport* transport, uint32_t baudrate);
#else
  /* 沒有 uxrclient 時此檔不會被編，但為了安全留個空宣告避免誤含 */
  typedef struct uxrSerialTransport_ { void* platform; } uxrSerialTransport;
  static inline bool uxr_init_zephyr_serial_transport(uxrSerialTransport* t, uint32_t b){ (void)t; (void)b; return false; }
#endif
```
