## CMakeLists.txt
```
cmake_minimum_required(VERSION 3.20.0)
find_package(Zephyr REQUIRED HINTS $ENV{ZEPHYR_BASE})
project(nrf52_base_app)
target_sources(app PRIVATE src/main.c)
```

## prj.conf
```kconfig
# ---- minimal console/log, safe on Zephyr 4.1 ----
CONFIG_SERIAL=y
CONFIG_UART_CONSOLE=y
CONFIG_CONSOLE=y
CONFIG_PRINTK=y
CONFIG_LOG=y
CONFIG_LOG_MODE_MINIMAL=y
CONFIG_MAIN_STACK_SIZE=2048

# ---- avoid legacy/posix (這些符號存在且安全) ----
CONFIG_POSIX_API=n
CONFIG_NEWLIB_LIBC=n
```

## boards/nrf52840dk_nrf52840.overlay
```dts
/* 最小化：僅確保 UART0 為 console */
&uart0 {
    status = "okay";
    current-speed = <115200>;
};
```

## src/main.c
```c
#include <zephyr/kernel.h>
#include <zephyr/sys/printk.h>

void main(void)
{
    printk("xrce-link-lab: nRF52840 baseline app running.\n");
    for (int i = 0; ; ++i) {
        printk("heartbeat %d\n", i);
        k_sleep(K_MSEC(500));
    }
}
```
