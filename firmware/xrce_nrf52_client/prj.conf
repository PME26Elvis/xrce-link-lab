## CMakeLists.txt
```
cmake_minimum_required(VERSION 3.20.0)
find_package(Zephyr REQUIRED HINTS $ENV{ZEPHYR_BASE})
project(xrce_nrf52_client)

target_sources(app PRIVATE
  src/main.c
  src/transport_stub.c
)

# 之後把 eProsima uxrclient 換成真實傳輸時，只要改這裡把第三方源加進來即可
# target_sources(app PRIVATE third_party/uxrclient/src/c/profile/transport/serial/serial_transport.c ...)
```

## prj.conf
```kconfig
# --- 基礎 console ---
CONFIG_SERIAL=y
CONFIG_UART_CONSOLE=y
CONFIG_CONSOLE=y
CONFIG_PRINTK=y
CONFIG_LOG=y
CONFIG_LOG_MODE_MINIMAL=y
CONFIG_MAIN_STACK_SIZE=3072

# --- 關閉不需要的 POSIX/NEWLIB，降低雜訊 ---
CONFIG_POSIX_API=n
CONFIG_NEWLIB_LIBC=n
```

## boards/nrf52840dk_nrf52840.overlay
```dts
&uart0 {
    status = "okay";
    current-speed = <115200>;
};
```

## src/main.c
```c
#include <zephyr/kernel.h>
#include <zephyr/sys/printk.h>
#include <string.h>
#include "transport_stub.h"

/* 先做可見的「假心跳」，確保在 Renode 上能跑、能輸出 */
static const char* HB = "XRCE-STUB heartbeat\n";

void main(void)
{
    printk("xrce client (stub) starting...\n");
    if (!xrce_transport_open()) {
        printk("xrce transport open failed\n");
        return;
    }

    int i = 0;
    while (1) {
        char buf[64];
        int n = snprintk(buf, sizeof(buf), "[%04d] %s", i++, HB);
        xrce_transport_write((const uint8_t*)buf, (size_t)n);
        k_sleep(K_MSEC(500));
    }
}
```

## src/transport_stub.c
```c
#include "transport_stub.h"
#include <zephyr/kernel.h>
#include <zephyr/drivers/uart.h>
#include <zephyr/sys/printk.h>
#include <string.h>

static const struct device* s_uart;

bool xrce_transport_open(void)
{
    s_uart = DEVICE_DT_GET(DT_CHOSEN(zephyr_console));
    if (!device_is_ready(s_uart)) {
        printk("xrce: UART not ready\n");
        return false;
    }
    printk("xrce: UART ready (stub transport)\n");
    return true;
}

void xrce_transport_close(void)
{
    ARG_UNUSED(s_uart);
}

int xrce_transport_write(const uint8_t* data, size_t len)
{
#if defined(CONFIG_UART_CONSOLE)
    for (size_t i = 0; i < len; ++i) {
        printk("%c", data[i]);
    }
    return (int)len;
#else
    ARG_UNUSED(data); ARG_UNUSED(len);
    return -1;
#endif
}

int xrce_transport_read(uint8_t* data, size_t maxlen, int timeout_ms)
{
    /* 占位：目前不從 UART 讀；之後接上 uxrclient 時再實作 */
    ARG_UNUSED(data); ARG_UNUSED(maxlen); ARG_UNUSED(timeout_ms);
    k_sleep(K_MSEC(timeout_ms));
    return 0;
}
```

## src/transport_stub.h
```c
#pragma once
#include <zephyr/kernel.h>
#include <stdbool.h>

#ifdef __cplusplus
extern "C" {
#endif

bool xrce_transport_open(void);
void xrce_transport_close(void);
int  xrce_transport_write(const uint8_t* data, size_t len);
int  xrce_transport_read(uint8_t* data, size_t maxlen, int timeout_ms);

#ifdef __cplusplus
}
#endif
```

## src/transport_zephyr_serial.c
```c
#include "transport_zephyr_serial.h"
#include <zephyr/drivers/uart.h>
#include <zephyr/kernel.h>

typedef struct
{
    const struct device* dev;
} zephyr_serial_platform;

bool uxr_init_zephyr_serial_transport(
    uxrSerialTransport* transport,
    const char* dev,
    uint32_t baudrate)
{
    (void) baudrate; // 暫不調整，Zephyr DTS 已定義
    zephyr_serial_platform* plat = (zephyr_serial_platform*) malloc(sizeof(*plat));
    if(!plat) return false;
    plat->dev = device_get_binding(dev);
    if(!plat->dev) return false;
    transport->platform = plat;
    return true;
}

bool uxr_close_serial_transport(uxrSerialTransport* transport)
{
    free(transport->platform);
    return true;
}

size_t uxr_write_serial_data(
    uxrSerialTransport* transport,
    const uint8_t* buf, size_t len, uint8_t* err)
{
    zephyr_serial_platform* plat = (zephyr_serial_platform*) transport->platform;
    for(size_t i=0; i<len; ++i)
        uart_poll_out(plat->dev, buf[i]);
    *err = 0;
    return len;
}

size_t uxr_read_serial_data(
    uxrSerialTransport* transport,
    uint8_t* buf, size_t len, int timeout, uint8_t* err)
{
    zephyr_serial_platform* plat = (zephyr_serial_platform*) transport->platform;
    size_t count = 0;
    int64_t end = k_uptime_get() + timeout;
    while(count < len && k_uptime_get() < end)
    {
        unsigned char c;
        if(uart_poll_in(plat->dev, &c) == 0)
        {
            buf[count++] = c;
        }
    }
    *err = 0;
    return count;
}
```

## src/transport_zephyr_serial.h
```c
#pragma once
#include <uxr/client/transport.h>

#ifdef __cplusplus
extern "C" {
#endif

bool uxr_init_zephyr_serial_transport(
    uxrSerialTransport* transport,
    const char* dev,
    uint32_t baudrate);

#ifdef __cplusplus
}
#endif
```
