## CMakeLists.txt
```
cmake_minimum_required(VERSION 3.20.0)
find_package(Zephyr REQUIRED HINTS $ENV{ZEPHYR_BASE})
project(xrce_link_lab_app)
target_sources(app PRIVATE src/main.c)
```

## west.yml
```
manifest:
  version: "1.2"
  self:
    path: app

  remotes:
    - name: zephyrproject-rtos
      url-base: https://github.com/zephyrproject-rtos
    - name: microros
      url-base: https://github.com/micro-ROS

  projects:
    - name: zephyr
      remote: zephyrproject-rtos
      revision: v4.1.0
      west-commands: scripts/west_commands

    - name: micro_ros_zephyr_module
      remote: microros
      revision: kilted
      path: modules/libmicroros
```

## prj.conf
```kconfig
# 最小輸出到 UART/console 的設定
CONFIG_PRINTK=y
CONFIG_SERIAL=y
CONFIG_UART_CONSOLE=y
```

## relax.conf
```kconfig
# 關掉「Kconfig 警告視為錯誤」（Zephyr 4.x 正名）
CONFIG_KCONFIG_WARNINGS_AS_ERRORS=n

# 舊名／變體（沒這符號就忽略；保險）
CONFIG_KCONFIG_WARN_AS_ERROR=n

# 降噪：避免拉出某些 NRFX select 鏈（不影響我們的 UART/printk）
CONFIG_POSIX_CLOCK=n
CONFIG_UART_0_ENHANCED_POLL_OUT=n

# 降噪：時鐘來源改 RC，避開 LFXO 兩段流程的 select 噪音
CONFIG_CLOCK_CONTROL_NRF_K32SRC_XTAL=n
CONFIG_CLOCK_CONTROL_NRF_K32SRC_RC=y
```

## empty.overlay
```dts
/* Empty overlay for native_posix — keep hardware-only nodes out. */
```

## src/main.c
```c
#include <zephyr/kernel.h>
#include <zephyr/sys/printk.h>

int main(void)
{
    printk("XRCE-Link-Lab: Zephyr baseline OK\n");
    return 0;
}
```
